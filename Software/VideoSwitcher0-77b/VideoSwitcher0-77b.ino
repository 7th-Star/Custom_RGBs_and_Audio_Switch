#include <Arduino.h>
#include <U8g2lib.h>
#include <EEPROM.h>
#include <Wire.h>
#define CLK 2
#define DT 3

byte currentStateCLK;
byte lastStateCLK;
byte input = EEPROM.read(0);
byte currentinput = 0;
byte dplayedinput = 1;
unsigned long lastdisplaychange = 0;
unsigned long currenttime = 0;
unsigned long encodewait = 0;

const byte demuxout[] PROGMEM = {B00100000,B00000000,B00100000,B00000000,B00100000,B00000000,B00100000,B00000000,B00100000,B00000000,B00100000,B00100000,B00000000,B00100000,
B00000000,};

static const unsigned char playstation_pic[] U8X8_PROGMEM = {
0x00, 0x00, 0x00, 0x00, 0x00, 0x00, 0x00, 0x00, 0x00, 0x00, 0x00, 0x00, 0x00, 0x00, 0x00, 0x00, 
0x00, 0x00, 0x00, 0x00, 0x00, 0x00, 0x00, 0x00, 0x00, 0x00, 0x00, 0x00, 0x00, 0x00, 0x00, 0x00, 
0x00, 0x00, 0x00, 0x00, 0x00, 0x00, 0x00, 0x00, 0x00, 0x00, 0x00, 0x00, 0x00, 0x00, 0x00, 0x00, 
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0x00, 0x00, 0x00, 0x00, 0x00, 0x00, 0x00, 0x00, 0x00, 0x00, 0x00, 0x00, 0x00, 0x00, 0x00, 0x00, 
};

static const unsigned char xbox_pic[] U8X8_PROGMEM = {
0x00, 0x00, 0x00, 0x00, 0x00, 0x00, 0x00, 0x00, 0x00, 0x00, 0x00, 0x00, 0x00, 0x00, 0x00, 0x00, 
0x00, 0x00, 0x00, 0x00, 0x00, 0x00, 0x00, 0x00, 0x00, 0x00, 0x00, 0x00, 0x00, 0x00, 0x00, 0x00, 
0x00, 0x00, 0x00, 0x00, 0x00, 0x00, 0x00, 0x00, 0x00, 0x00, 0x00, 0x00, 0x00, 0x00, 0x00, 0x00, 
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0x00, 0x00, 0x00, 0x00, 0x00, 0x00, 0x00, 0x00, 0x00, 0x00, 0x00, 0x00, 0x00, 0x00, 0x00, 0x00, 
};

static const unsigned char boot_pic[] U8X8_PROGMEM = {
0x00, 0x00, 0x00, 0x00, 0x00, 0x00, 0x00, 0x00, 0x00, 0x00, 0x00, 0x00, 0x00, 0x00, 0x00, 0x00, 
0x00, 0x00, 0x00, 0x00, 0x00, 0x00, 0x00, 0x00, 0x00, 0x00, 0x00, 0x00, 0x00, 0x00, 0x00, 0x00, 
0x00, 0x00, 0x00, 0x00, 0x00, 0x00, 0x00, 0x00, 0x00, 0x00, 0x00, 0x00, 0x00, 0x00, 0x00, 0x00, 
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0x00, 0x00, 0x00, 0x00, 0x00, 0x00, 0x00, 0x00, 0x00, 0x00, 0x00, 0x00, 0x00, 0x00, 0x00, 0x00, 
};

U8G2_SH1106_128X64_NONAME_1_HW_I2C u8g2(U8G2_R0, /* reset=*/ U8X8_PIN_NONE);

void setup(void) {
  
  u8g2.begin();

  if (input < 0 || input > 14){
  input = 0;  
  }

  //Serial.begin(9600);

  DDRB = B00111111;
  DDRD = B00000010;
    
  lastStateCLK = digitalRead(CLK);
  
  attachInterrupt(0, Encoderchange, CHANGE);
  attachInterrupt(1, Encoderchange, CHANGE);

  bootscreen();
  displayinput();
  setinput();
}

void playstation (){     
   
  u8g2.firstPage();
  do {
    u8g2.setFont(u8g2_font_ncenB14_tr);
    u8g2.drawXBMP(0,0, 128,64, playstation_pic);
  } while ( u8g2.nextPage() ); 
  
}

//void gamecube (){
  
//  u8g2.firstPage();
//  do {
//    u8g2.setFont(u8g2_font_ncenB14_tr);
//    u8g2.drawXBMP(0,0, 128,64, gamecube_pic);
//  } while ( u8g2.nextPage() );
  
// }

//void laserdisc(){

//  u8g2.firstPage();
//  do {
//    u8g2.setFont(u8g2_font_ncenB14_tr);
//    u8g2.drawXBMP(0,0, 128,64, laserdisc_pic);
//  } while ( u8g2.nextPage() ); 
  
//}

//void playstation2(){
 
 // u8g2.firstPage();
 // do {
 //   u8g2.setFont(u8g2_font_ncenB14_tr);
 //   u8g2.drawXBMP(0,0, 128,64, playstation2_pic);
 // } while ( u8g2.nextPage() );
  
//}

//void saturn(){

//  u8g2.firstPage();
//  do {
//    u8g2.setFont(u8g2_font_ncenB14_tr);
//    u8g2.drawXBMP(0,0, 128,64, saturn_pic);
//  } while ( u8g2.nextPage() );

//}

void xbox(){
  
  u8g2.firstPage();
  do {
    u8g2.setFont(u8g2_font_ncenB14_tr);
    u8g2.drawXBMP(0,0, 128,64, xbox_pic);
  } while ( u8g2.nextPage() );
  
}

//void snes(){

//  u8g2.firstPage();
//  do {
//    u8g2.setFont(u8g2_font_ncenB14_tr);
//    u8g2.drawXBMP(0,0, 128,64, snes_pic);
//  } while ( u8g2.nextPage() );
  
//}

//void genesis(){

//  u8g2.firstPage();
//  do {
//    u8g2.setFont(u8g2_font_ncenB14_tr);
//    u8g2.drawXBMP(0,0, 128,64, genesis_pic);
//  } while ( u8g2.nextPage() );
  
//}

//void mastersystem(){
 
//  u8g2.firstPage();
//  do {
//    u8g2.setFont(u8g2_font_ncenB14_tr);
//    u8g2.drawXBMP(0,0, 128,64, mastersystem_pic);
//  } while ( u8g2.nextPage() );

//}

//void (*selectinput[])() = {playstation,gamecube,laserdisc,playstation2,saturn,xbox,snes,genesis,mastersystem};

void (*selectinput[])() = {playstation,xbox};

void loop(void) {

  currenttime = millis();
  
   if (dplayedinput != input){
    displayinput();}  
 
  if (input != currentinput && currenttime > lastdisplaychange){
    setinput();}

  if (currenttime + 1001 - lastdisplaychange > 10000){
    u8g2.firstPage();
  do {
    u8g2.setFont(u8g2_font_ncenB14_tr);
  } while ( u8g2.nextPage() ); 
  }


}

void displayinput(){

  (*selectinput[input])();
  lastdisplaychange = currenttime + 1000;
  dplayedinput = input;
   
}

void Encoderchange(){

  currenttime = millis();

  currentStateCLK = digitalRead(CLK);
  
  if (currentStateCLK != lastStateCLK  && currentStateCLK == 1 && currenttime >= encodewait){
    
    if (digitalRead(DT) != currentStateCLK) 
    {if (input > 0) {input --;}
     else {input = 1;}}
    else 
    {if (input < 1) {input ++;}
     else {input = 0;}}
     encodewait = currenttime + 350;
  }
     lastStateCLK = currentStateCLK;
}

void setinput(){

 byte buffer5 pgm_read_byte(&demuxout[input]);
 PORTB = buffer5;
 EEPROM.write(0, input);   
 currentinput = input;
  
}

void bootscreen(){
 
   u8g2.firstPage();
  do {
    u8g2.setFont(u8g2_font_ncenB14_tr);
    u8g2.drawXBMP(0,0, 128,64, boot_pic);
  } while ( u8g2.nextPage() );
 delay(3000);
      
}
